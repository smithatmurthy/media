## Documentation/devicetree/bindings/leds/common.txt
```
Common leds properties.

Optional properties for child nodes:
- label : The label for this LED.  If omitted, the label is
  taken from the node name (excluding the unit address).
- iout-torch : Array of maximum intensities in microamperes of the torch
	led currents in order from sub-led 0 to N-1, where N is the number
	of torch sub-leds exposed by the device
- iout-flash : Array of maximum intensities in microamperes of the flash
	led currents in order from sub-led 0 to N-1, where N is the number
	of flash sub-leds exposed by the device
- iout-indicator : Array of maximum intensities in microamperes of
	the indicator led currents in order from sub-led 0 to N-1,
	where N is the number of indicator sub-leds exposed by the device
- flash-timeout : timeout in microseconds after which flash led
	is turned off

- linux,default-trigger :  This parameter, if present, is a
    string defining the trigger assigned to the LED.  Current triggers are:
     "backlight" - LED will act as a back-light, controlled by the framebuffer
		   system
     "default-on" - LED will turn on (but for leds-gpio see "default-state"
		    property in Documentation/devicetree/bindings/gpio/led.txt)
     "heartbeat" - LED "double" flashes at a load average based rate
     "ide-disk" - LED indicates disk activity
     "timer" - LED flashes at a fixed, configurable rate

Examples:

system-status {
	label = "Status";
	linux,default-trigger = "heartbeat";
	iout-torch = <500 500>;
	iout-flash = <1000 1000>;
	iout-indicator = <100 100>;
	flash-timeout = <1000>;

	...
};
```

## Documentation/devicetree/bindings/leds/leds-aat1290.txt
```
* Skyworks Solutions, Inc. AAT1290 Current Regulator for Flash LEDs

Required properties:

- compatible : should be "skyworks,aat1290"
- gpios : two gpio pins in order FLEN, EN/SET
- skyworks,flash-timeout : maximum flash timeout in microseconds -
			   it can be calculated using following formula:
			   T = 8.82 * 10^9 * Ct

Example:

flash_led: flash-led {
	compatible = "skyworks,aat1290";
	gpios = <&gpj1 1 0>, <&gpj1 2 0>;
	flash-timeout = <1940000>;
}
```

## Documentation/devicetree/bindings/leds/leds-flash-manager.txt
```
* LED Flash Manager

Flash manager is a part of LED Flash Class. It maintains
all the flash led devices which have their external strobe
signals routed through multiplexing devices.
The multiplexers are aggregated in the standalone 'flash_muxes'
node as subnodes which are referenced by the flash led devices.


flash_muxes node
----------------

muxN subnode
------------

There must be at least one muxN subnode, where N is the identifier
of the node, present in the flash_muxes node. One muxN node
represents one multiplexer.

Required properties (mutually exclusive):
- gpios		: specifies the gpio pins used to set the states
		  of mux selectors, LSB first
- mux-async	: phandle to the node of the multiplexing device



flash led device node
---------------------

Following subnodes must be added to the LED Flash Class device
tree node described in Documentation/devicetree/bindings/leds/common.txt.


gate-software-strobe subnode
----------------------------

The node defines configuration of multiplexers that needs
to be applied to route software strobe signal to the flash
led device.

Required properties:
- mux		: phandle to the muxN node defined
		  in the flash_muxes node
- mux-line-id	: mux line identifier

Optional subnodes:
- gate-software-strobe : if there are many multiplexers to configure,
			 they can be recursively nested.


gate-external-strobeN subnode
-----------------------------

The node defines configuration of multiplexers that needs
to be applied to route external strobe signal to the flash
led device. A flash led device can have many external strobe
signal sources.

Required properties:
- mux			: phandle to the muxN node defined
			  in the flash_muxes node
- mux-line-id		: mux line identifier
Optional properties:
- strobe-provider	: phandle to the device providing the
			  strobe signal. It is expected only
			  on the first level node. The referenced
			  node is expected to have 'compatible'
			  property, as providers are labelled
			  with it in the LED subsystem

Optional subnodes:
- gate-external-strobeN	: if there are many multiplexers to configure,
			  they can be recursively nested.


Example:

Following board configuration is assumed in this example:

    ---------- ----------
    | FLASH1 | | FLASH2 |
    ---------- ----------
           \(0)   /(1)
          ----------
          |  MUX1  |
          ----------
              |
          ----------
          |  MUX2  |
          ----------
           /(0)   \(1)
      ----------  --------------------
      |  MUX3  |  | SOC FLASHEN GPIO |
      ----------  --------------------
       /(0)   \(1)
----------- -----------
| SENSOR1 | | SENSOR2 |
----------- -----------


dummy_mux: led_mux {
	compatible = "led-async-mux";
};

flash_muxes {
	flash_mux1: mux1 {
                gpios = <&gpj1 1 0>, <&gpj1 2 0>;
	};

	flash_mux2: mux2 {
		mux-async = <&dummy_mux>;
	};

	flash_mux3: mux3 {
                gpios = <&gpl1 1 0>, <&gpl1 2 0>;
	};
};

max77693-flash {
	compatible = "maxim,max77693-flash";

	//other device specific properties here

	gate-software-strobe {
		mux = <&flash_mux1>;
		mux-line-id = <0>;

		gate-software-strobe {
			mux = <&flash_mux2>;
			mux-line-id = <1>;
		};
	};

	gate-external-strobe1 {
		strobe-provider = <&s5c73m3_spi>;
		mux = <&flash_mux1>;
		mux-line-id = <0>;

		gate-external-strobe1 {
			mux = <&flash_mux2>;
			mux-line-id = <0>;

			gate-external-strobe1 {
				mux = <&flash_mux3>;
				mux-line-id = <0>;
			};
		};
	};

	gate-external-strobe2 {
		strobe-provider = <&s5k6a3>;
		mux = <&flash_mux1>;
		mux-line-id = <0>;

		gate-external-strobe2 {
			mux = <&flash_mux2>;
			mux-line-id = <0>;

			gate-external-strobe2 {
				mux = <&flash_mux3>;
				mux-line-id = <1>;
			};
		};
	};
};
```

## Documentation/devicetree/bindings/media/exynos-fimc-lite.txt
```
Exynos4x12/Exynos5 SoC series camera interface (FIMC-LITE)

Required properties:

- compatible : should be "samsung,exynos4212-fimc" for Exynos4212 and
	       Exynos4412 SoCs;
- reg	     : physical base address and size of the device memory mapped
	       registers;
- interrupts : should contain FIMC-LITE interrupt;

For every fimc-lite node a numbered alias should be present in the aliases
node. Aliases are in form of fimc-lite<n>, where <n> is an integer (0...N)
specifying the IP's instance index.
```

## Documentation/devicetree/bindings/media/exynos4-fimc-is.txt
```
Exynos4x12 SoC series Imaging Subsystem (FIMC-IS)

The FIMC-IS is an subsystem for processing image signal from an image sensor.
The Exynos4x12 SoC series FIMC-IS V1.5 comprises of a dedicated ARM Cortex-A5
processor, ISP, DRC and FD IP blocks and peripheral IPs such as I2C, SPI, UART
bus controllers, Multi-PWM and ADC.

fimc-is node
------------

Required properties:

- compatible : should be "samsung,exynos4212-fimc-is" for Exynos4212 and
	       Exynos4412 SoCs;
- reg	     : physical base address and size of the device memory mapped
	       registers;
- interrupts : should contain FIMC-IS interrupts;

The following are the FIMC-IS peripheral device nodes and can be specified
either standalone or as fimc-is child nodes.

pmu subnode
-----------

Required properties:
 - reg	: should contain PMU physical base address of the memory mapped
          registers and size, the value of size should be 0x3000.


i2c-isp (ISP I2C bus controller) nodes
------------------------------------------

Required properties:

- compatible : should be "samsung,exynos4212-i2c-isp" for Exynos4212 and
	       Exynos4412 SoCs;
- reg	     : physical base address and size of the device memory mapped
	       registers;

For the above nodes it is required to specify a pinctrl state named "default",
according to the pinctrl bindings defined in ../pinctrl/pinctrl-bindings.txt.
```

## Documentation/devicetree/bindings/media/samsung-fimc.txt
```
Samsung S5P/EXYNOS SoC Camera Subsystem (FIMC)
----------------------------------------------

The S5P/Exynos SoC Camera subsystem comprises of multiple sub-devices
represented by separate device tree nodes. Currently this includes: FIMC (in
the S5P SoCs series known as CAMIF), MIPI CSIS, FIMC-LITE and FIMC-IS (ISP).

The sub-subdevices are defined as child nodes of the common 'camera' node which
also includes common properties of the whole subsystem not really specific to
any single sub-device, like common camera port pins or the CAMCLK clock outputs
for external image sensors attached to an SoC.

Common 'camera' node
--------------------

Required properties:

- compatible : must be "samsung,fimc", "simple-bus"

The 'camera' node must include at least one 'fimc' child node.


'fimc' device nodes
-------------------

Required properties:

- compatible : "samsung,s5pv210-fimc" for S5PV210, "samsung,exynos4210-fimc"
  for Exynos4210 and "samsung,exynos4212-fimc" for Exynos4x12 SoCs;
- reg : physical base address and size of the device  memory mapped registers;
- interrupts : FIMC interrupt to the CPU should be described here;
- samsung,pix-limits : an array of supported image sizes in pixels, for details
  refer to Table 2-1 in the S5PV210 SoC User Manual.

For every fimc node a numbered alias should be present in the aliases node.
Aliases are of the form fimc<n>, where <n> is an integer (0...N) specifying
the IP's instance index.

Optional properties:

- clock-frequency : maximum FIMC local clock (LCLK) frequency;
- samsung,min-pix-sizes : an array specyfing minimum image size in pixels at
  the FIMC input and output DMA, in the first and second cell respectively.
  Default value when this property is not present is <16 16>;
- samsung,min-pix-alignment : minimum supported image height alignment (first
  cell) and the horizontal image offset (second cell). The values are in pixels
  and default to <2 1> when this property is not present;
- samsung,mainscaler-ext : a boolean property indicating whether the FIMC IP
  supports extended image size and has CIEXTEN register;
- samsung,rotators : a bitmask specifying whether this IP has the input and
  the output rotator. Bits 4 and 0 correspond to input and output rotator
  respectively. If a rotator is present its corresponding bit should be set.
  Default value when this property is not specified is 0x11.
- samsung,cam-if : a bolean property indicating whether the IP block includes
  the camera input interface.
- samsung,isp-wb : this property must be present if the IP block has the ISP
  writeback input.


Example:

	aliases {
		fimc0 = &fimc_0;
	};

	camera {
		compatible = "samsung,fimc", "simple-bus";
		#address-cells = <1>;
		#size-cells = <1>;
		status = "okay";

		fimc_0: fimc@11800000 {
			compatible = "samsung,exynos4210-fimc";
			reg = <0x11800000 0x1000>;
			interrupts = <0 85 0>;
			status = "okay";
		};

		csis_0: csis@11880000 {
			compatible = "samsung,exynos4210-csis";
			reg = <0x11880000 0x1000>;
			interrupts = <0 78 0>;
		};
	};

[1] Documentation/devicetree/bindings/media/soc/samsung-mipi-csis.txt
```

## Documentation/devicetree/bindings/media/samsung-s5c73m3.txt
```
Samsung LSI S5C73M3 8M pixel camera
-----------------------------------

The S5C73M3 camera module uses I2C bus as the main device control bus
and SPI bus, mainly for transferring the firmware to and from the device.
Two slave slave device nodes are required corresponding to these busses
and should be placed under respective bus controller nodes.

I2C slave device node
---------------------

Required properties:

- compatible	    : "samsung,s5c73m3";
- reg		    : i2c slave address of the sensor;
- vdd-int-supply    : digital power supply (1.2V);
- vdda-supply	    : analog power supply (1.2V);
- vdd-reg-supply    : regulator input power supply (2.8V);
- vddio-host-supply : host I/O power supply (1.8V to 2.8V);
- vddio-cis-supply  : CIS I/O power supply (1.2V to 1.8V);
- vdd-af-supply	    : lens power supply (2.8V);
- gpios		    : GPIOs in order: STANDBY, RESET;
- clocks	    : contains the sensor's master clock specifier;
- clock-names	    : contains "mclk" entry;

Optional properties:

- clock-frequency   : master clock frequency in Hz; if this property is
		      not specified default 24 MHz value will be used.

The common video interfaces bindings (see video-interfaces.txt) should be
used to specify link to the host capture interface.  The S5C73M3 device
node should contain one 'port' child node with an 'endpoint' subnode.
The following are properties specific to those nodes.

endpoint subnode
----------------

- data-lanes : (optional) specifies MIPI CSI-2 data lanes as covered in
  video-interfaces.txt.  This property can be only used to specify number
  of data lanes, i.e. the array's content is unused, only its length is
  meaningful. When this property is not specified default value of 4 lanes
  will be used.

SPI slave device node
---------------------

Required properties:

- compatible	    : "samsung,s5c73m3";

For more details see description of the SPI busses bindings
(../spi/spi-bus.txt) and bindings of a specific bus controller.

Example:

i2c@138A000000 {
	...
	s5c73m3@3c {
		compatible = "samsung,s5c73m3";
		reg = <0x3c>;
		vdd-int-supply = <&buck9_reg>;
		vdda-supply = <&ldo17_reg>;
		vdd-reg-supply = <&cam_io_reg>;
		vddio-host-supply = <&ldo18_reg>;
		vddio-cis-supply = <&ldo9_reg>;
		vdd-af-supply = <&cam_af_reg>;
		clock-frequency = <24000000>;
		clocks = <&clk 0>;
		clock-names = "mclk";
		gpios = <&gpm0 1 1>, /* STANDBY */
			<&gpf1 3 1>; /* RESET */
		port {
			s5c73m3_ep: endpoint {
				remote-endpoint = <&csis0_ep>;
				data-lanes = <1 2 3 4>;
			};
		};
	};
};

spi@1392000 {
	...
	s5c73m3_spi: s5c73m3 {
		compatible = "samsung,s5c73m3";
		reg = <0>;
		...
	};
};
```
