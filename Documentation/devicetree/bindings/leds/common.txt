## Documentation/devicetree/bindings/media/soc/samsung-fimc.txt
```
Samsung S5P/EXYNOS SoC Camera Subsystem (FIMC)
----------------------------------------------

The Exynos Camera subsystem comprises of multiple sub-devices that are
represented by separate platform devices. Some of the IPs come in different
variants across the SoC revisions (FIMC) and some remain mostly unchanged
(MIPI CSIS, FIMC-LITE).

All those sub-subdevices are defined as parent nodes of the common device
node, which also includes common properties of the whole subsystem not really
specific to any single sub-device, like common camera port pins or external
clocks for image sensors attached to the SoC.

Common 'camera' node
--------------------

Required properties:

- compatible	   : must be "samsung,fimc", "simple-bus"

The 'camera' node must include at least one 'fimc' child node.


'fimc' device nodes
-------------------

Required properties:

- compatible : "samsung,s5pv210-fimc" for S5PV210,
	       "samsung,exynos4210-fimc" for Exynos4210,
	       "samsung,exynos4212-fimc" for Exynos4212/4412 SoCs;
- reg	     : physical base address and size of the device memory mapped
	       registers;
- interrupts : FIMC interrupt to the CPU should be described here;

For every fimc node a numbered alias should be present in the aliases node.
Aliases are of the form fimc<n>, where <n> is an integer (0...N) specifying
the IP's instance index.

Optional properties

 - clock-frequency - maximum FIMC local clock (LCLK) frequency

'fimc-lite' device nodes
-----------------------

Required properties:

- compatible : should be "samsung,exynos4212-fimc" for Exynos4212 and
	       Exynos4412 SoCs;
- reg	     : physical base address and size of the device memory mapped
	       registers;
- interrupts : should contain FIMC-LITE interrupt;

For every fimc-lite node a numbered alias should be present in the aliases
node. Aliases are in form of fimc-lite<n>, where <n> is an integer (0...N)
specifying the IP's instance index.


'parallel-ports' node
---------------------

This node should contain child 'port' nodes specifying active parallel video
input ports. It includes camera A and camera B inputs. 'reg' property in the
port nodes specifies data input - 0, 1 indicates input A, B respectively.

Optional properties

- samsung,camclk-out	 : specifies clock output for remote sensor,
			   0 - CAM_A_CLKOUT, 1 - CAM_B_CLKOUT;

Image sensor nodes
------------------

The sensor device nodes should be added as their control bus controller
(e.g. I2C0) child nodes and linked to a port node in the csis or parallel-ports
node, using common the common video interfaces bindings, i.e. port/endpoint
node pairs. The implementation of this binding requires clock-frequency
property to be present in the sensor device nodes.


Example:

	aliases {
		csis0 = &csis_0;
		fimc0 = &fimc_0;
	};

	/* Parallel bus IF sensor */
	i2c_0: i2c@13860000 {
		s5k6aa: sensor@3c {
			compatible = "samsung,s5k6aafx";
			reg = <0x3c>;
			vddio-supply = <...>;

			clock-frequency = <24000000>;
			clocks = <...>;
			clock-names = "mclk";

			port {
				s5k6aa_ep: endpoint {
					remote-endpoint = <&fimc0_ep>;
					bus-width = <8>;
					hsync-active = <0>;
					hsync-active = <1>;
					pclk-sample = <1>;
				};
			};
		};
	};

	/* MIPI CSI-2 bus IF sensor */
	s5c73m3: sensor@0x1a {
		compatible = "samsung,s5c73m3";
		reg = <0x1a>;
		vddio-supply = <...>;

		clock-frequency = <24000000>;
		clocks = <...>;
		clock-names = "mclk";

		port {
			s5c73m3_1: endpoint {
				data-lanes = <1>, <2>, <3>, <4>;
				remote-endpoint = <&csis0_ep>;
			};
		};
	};

	camera {
		compatible = "samsung,fimc", "simple-bus";
		#address-cells = <1>;
		#size-cells = <1>;
		status = "okay";

		/* parallel camera ports */
		parallel-ports {
			/* camera A input */
			port@0 {
				reg = <1>;
				fimc0_ep: endpoint {
					remote-endpoint = <&s5k6aa_ep>;
					bus-width = <8>;
					hsync-active = <0>;
					hsync-active = <1>;
					pclk-sample = <1>;
				};
			};
		};

		fimc_0: fimc@11800000 {
			compatible = "samsung,exynos4210-fimc";
			reg = <0x11800000 0x1000>;
			interrupts = <0 85 0>;
			status = "okay";
		};

		csis_0: csis@11880000 {
			compatible = "samsung,exynos4210-csis";
			reg = <0x11880000 0x1000>;
			interrupts = <0 78 0>;
			max-data-lanes = <4>;
			/* camera C input */
			port {
				reg = <3>;
				csis0_ep: endpoint {
					remote-endpoint = <&s5c73m3_ep>;
					data-lanes = <1>, <2>, <3>, <4>;
					samsung,csis-hs-settle = <12>;
					samsung,camclk-out = <0>;
				};
			};
		};
	};

[1] Documentation/devicetree/bindings/media/soc/samsung-mipi-csis.txt
```

## Documentation/devicetree/bindings/mfd/max77693.txt
```
Maxim MAX77693 multi-function device

MAX77693 is a Multifunction device with the following submodules:
- PMIC,
- CHARGER,
- LED,
- MUIC,
- HAPTIC

It is interfaced to host controller using i2c.
This document describes the bindings for the mfd device.

Required properties:
- compatible : Must be "maxim,max77693".
- reg : Specifies the i2c slave address of PMIC block.
- interrupts : This i2c device has an IRQ line connected to the main SoC.
- interrupt-parent :  The parent interrupt controller.

Optional properties:
- regulators : The regulators of max77693 have to be instantiated under subnod
  named "regulators" using the following format.

	regulators {
		regualtor-compatible = ESAFEOUT1/ESAFEOUT2/CHARGER
		standard regulator constratints[*].
	};

	[*] refer Documentation/devicetree/bindings/regulator/regulator.txt

Optional node:
- led-flash : the LED submodule device node

Required properties of "led-flash" node:
- compatible : must be "maxim,max77693-flash"
- maxim,num-leds : number of connected leds
	Possible values: 1 or 2.
- maxim,fleds : array of current outputs in order: fled1, fled2
	Note: both current outputs can be connected to a single led
	Possible values:
		0 - the output is left disconnected,
		1 - a diode is connected to the output.

Optional properties of "led-flash" node:
- maxim,boost-mode :
	In boost mode the device can produce up to 1.2A of total current
	on both outputs. The maximum current on each output is reduced
	to 625mA then. If maxim,num-leds == <2> boost must be enabled
	(it defaults to 1 if not set):
	Possible values:
		0 - no boost,
		1 - adaptive mode,
		2 - fixed mode.
- iout-torch : Array of maximum intensities in microamperes of the torch
	led currents in order: fled1, fled2.
		15625 - 250000
- iout-flash : Array of maximum intensities in microamperes of the flash
	led currents in order: fled1, fled2.
	Range:
		15625 - 1000000 (max 625000 if boost mode is enabled)
- flash-timeout : timeout in microseconds after which flash led
		  is turned off
	Range:
		62500 - 1000000
- maxim,trigger : Array of flags indicating which trigger can activate given led
	in order: fled1, fled2
	Possible flag values (can be combined):
		1 - FLASH pin of the chip,
		2 - TORCH pin of the chip,
		4 - software via I2C command.
- maxim,trigger-type : Array of trigger types in order: flash, torch.
	Possible trigger types:
		0 - Rising edge of the signal triggers the flash/torch,
		1 - Signal level controls duration of the flash/torch.
- maxim,boost-vout : Output voltage of the boost module in millivolts.
- maxim,vsys-min : Low input voltage level in millivolts. Flash is not fired
	if chip estimates that system voltage could drop below this level due
	to flash power consumption.

Example:
	max77693@66 {
		compatible = "maxim,max77693";
		reg = <0x66>;
		interrupt-parent = <&gpx1>;
		interrupts = <5 2>;

		regulators {
			esafeout@1 {
				regulator-compatible = "ESAFEOUT1";
				regulator-name = "ESAFEOUT1";
				regulator-boot-on;
			};
			esafeout@2 {
				regulator-compatible = "ESAFEOUT2";
				regulator-name = "ESAFEOUT2";
				};
			charger@0 {
				regulator-compatible = "CHARGER";
				regulator-name = "CHARGER";
				regulator-min-microamp = <60000>;
				regulator-max-microamp = <2580000>;
					regulator-boot-on;
			};
		};
		led_flash: led-flash {
			compatible = "maxim,max77693-flash";
			iout-torch = <500000 0>;
			iout-flash = <1250000 0>;
			flash-timeout = <1000000 1000000>;
			maxim,num-leds = <1>;
			maxim,fleds = <1 1>;
			maxim,trigger = <7 7>;
			maxim,trigger-type = <0 1>;
			maxim,boost-mode = <1>;
			maxim,boost-vout = <5000>;
			maxim,vsys-min = <2400>;
		};
	};
```

## Documentation/devicetree/bindings/sound/max98504.txt
```
Maxim MAX98504 class D mono speaker amplifier

This device supports I2C control interface and an IRQ output signal. It features
a PCM and PDM digital audio interface (DAI) and a differential analog input.

Required properties:

 - compatible : "maxim,max98504"
 - reg : should contain the I2C slave device address
 - DVDD-supply, DIOVDD-supply, PVDD-supply: power supplies for the device,
   as covered in ../regulator/regulator.txt
 - interrupts : should specify the interrupt the device is connected to,
   as described in ../interrupt-controller/interrupts.txt

Example:

 max98504@31 {
	compatible = "maxim,max98504";
	reg = <0x31>;
	interrupt-parent = <&gpio_bank_0>;
	interrupts = <2 0>;

	DVDD-supply = <&regulator>;
	DIOVDD-supply = <&regulator>;
	PVDD-supply = <&regulator>;
};
```
